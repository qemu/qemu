## hw/char/Kconfig
```kconfig
config ESCC
    bool

config HTIF
    bool

config PARALLEL
    bool
    default y
    depends on ISA_BUS

config PL011
    bool
    # The PL011 has both a Rust and a C implementation
    select PL011_C if !HAVE_RUST
    select X_PL011_RUST if HAVE_RUST

config PL011_C
    bool

config SERIAL
    bool

config SERIAL_ISA
    bool
    default y
    depends on ISA_BUS
    select SERIAL

config SERIAL_MM
    bool
    select SERIAL

config SERIAL_PCI
    bool
    default y if PCI_DEVICES
    depends on PCI
    select SERIAL

config SERIAL_PCI_MULTI
    bool
    default y if PCI_DEVICES
    depends on PCI
    select SERIAL

config VIRTIO_SERIAL
    bool
    default y
    depends on VIRTIO

config MAX78000_UART
    bool

config STM32F2XX_USART
    bool

config STM32L4X5_USART
    bool

config CMSDK_APB_UART
    bool

config SCLPCONSOLE
    bool

config TERMINAL3270
    bool

config SH_SCI
    bool

config RENESAS_SCI
    bool

config AVR_USART
    bool

config DIVA_GSP
    bool

config MCHP_PFSOC_MMUART
    bool
    select SERIAL

config SIFIVE_UART
    bool

config GOLDFISH_TTY
    bool

config SHAKTI_UART
    bool

config IP_OCTAL_232
    bool
    default y
    depends on IPACK
```

## hw/core/Kconfig
```kconfig
config EMPTY_SLOT
    bool

config PTIMER
    bool

config DEVICE_TREE
    bool
    # fail the build if libfdt not found
    depends on FDT

config FITLOADER
    bool
    depends on DEVICE_TREE

config GENERIC_LOADER
    bool
    default y

config GUEST_LOADER
    bool
    default y
    depends on TCG && DEVICE_TREE

config OR_IRQ
    bool

config PLATFORM_BUS
    bool
    depends on DEVICE_TREE

config REGISTER
    bool

config SPLIT_IRQ
    bool

config EIF
    bool
    depends on LIBCBOR && GNUTLS
```

## hw/cpu/Kconfig
```kconfig
config A9MPCORE
    bool
    select A9_GTIMER
    select A9SCU       # snoop control unit
    select ARM_GIC
    select ARM_MPTIMER

config A15MPCORE
    bool
    select ARM_GIC

config ARM11MPCORE
    bool
    select ARM11SCU

config CPU_CLUSTER
    bool
```

## hw/display/Kconfig
```kconfig
config DDC
    bool
    depends on I2C
    select EDID

config EDID
    bool

config FW_CFG_DMA
    bool

config ADS7846
    bool

config VGA_CIRRUS
    bool
    default y if PCI_DEVICES
    depends on PCI
    select VGA

config G364FB
    bool

config JAZZ_LED
    bool

config PL110
    bool
    select FRAMEBUFFER

config SII9022
    bool
    depends on I2C
    select DDC

config SSD0303
    bool
    depends on I2C

config SSD0323
    bool

config VGA_PCI
    bool
    default y if PCI_DEVICES
    depends on PCI
    select VGA
    select EDID

config VGA_ISA
    bool
    depends on ISA_BUS
    select VGA

config VGA_ISA_MM
    bool
    select VGA

config VMWARE_VGA
    bool
    default y if PCI_DEVICES
    depends on PCI
    select VGA

config BOCHS_DISPLAY
    bool
    default y if PCI_DEVICES
    depends on PCI
    select VGA
    select EDID

config BLIZZARD
    bool

config FRAMEBUFFER
    bool

config MILKYMIST_TMU2
    bool
    depends on OPENGL && X11

config SM501
    bool
    select I2C
    select DDC
    select SERIAL

config TCX
    bool

config CG3
    bool

config ARTIST
    bool
    select FRAMEBUFFER

config VGA
    bool

config QXL
    bool
    depends on SPICE && PCI
    select VGA

config VIRTIO_GPU
    bool
    default y
    depends on VIRTIO
    select EDID

config VIRTIO_VGA
    bool
    # defaults to "N", enabled by specific boards
    depends on VIRTIO_PCI
    select VGA

config VHOST_USER_GPU
    bool
    default y
    depends on VIRTIO_GPU && VHOST_USER

config VHOST_USER_VGA
    bool
    default y
    depends on VIRTIO_VGA && VHOST_USER_GPU

config DPCD
    bool
    select AUX

config ATI_VGA
    bool
    default y if PCI_DEVICES
    depends on PCI
    select VGA
    select BITBANG_I2C
    select DDC

config MACFB
    bool
    select FRAMEBUFFER
    depends on NUBUS
```

## hw/dma/Kconfig
```kconfig
config RC4030
    bool

config PL080
    bool

config PL330
    bool

config I82374
    bool
    select I8257

config I8257
    bool

config ZYNQ_DEVCFG
    bool
    select REGISTER

config XLNX_ZDMA
    bool

config STP2000
    bool

config SIFIVE_PDMA
    bool

config XLNX_CSU_DMA
    bool
    select REGISTER
```

## Kconfig
```kconfig
source Kconfig.host
source backends/Kconfig
source accel/Kconfig
source dump/Kconfig
source target/Kconfig
source hw/Kconfig
source semihosting/Kconfig
source rust/Kconfig
```

## Kconfig.host
```kconfig
# These are "proxy" symbols used to pass config-host.mak values
# down to Kconfig.  See also kconfig_external_symbols in
# meson.build: these two need to be kept in sync.

config LINUX
    bool

config LIBCBOR
    bool

config GNUTLS
    bool

config OPENGL
    bool

config X11
    bool

config PIXMAN
    bool

config SPICE
    bool

config IVSHMEM
    bool

config TPM
    bool

config FDT
    bool

config VHOST_USER
    bool

config VHOST_VDPA
    bool

config VHOST_KERNEL
    bool

config VIRTFS
    bool

config MULTIPROCESS_ALLOWED
    bool
    imply MULTIPROCESS

config FUZZ
    bool
    select SPARSE_MEM

config VFIO_USER_SERVER_ALLOWED
    bool
    imply VFIO_USER_SERVER

config HV_BALLOON_POSSIBLE
    bool

config HAVE_RUST
    bool

config MAC_PVG
    bool
```

## accel/Kconfig
```kconfig
config WHPX
    bool

config NVMM
    bool

config HVF
    bool

config TCG
    bool

config KVM
    bool

config XEN
    bool
    select FSDEV_9P if VIRTFS
    select PCI_EXPRESS_GENERIC_BRIDGE
    select XEN_BUS
```

## acx100/Kconfig
```kconfig
config ACX
	tristate "TI acx100/acx111 802.11b/g wireless chipsets"
	depends on NET_RADIO && EXPERIMENTAL && (USB || PCI)
	select FW_LOADER
	---help---
	A driver for 802.11b/g wireless cards based on
	Texas Instruments acx100 and acx111 chipsets.

	This driver supports Host AP mode that allows
	your computer to act as an IEEE 802.11 access point.
	This driver is new and experimental.

	Texas Instruments did not take part in development of this driver
	in any way, shape or form.

	The driver can be compiled as a module and will be named "acx".

config ACX_PCI
	bool "TI acx100/acx111 802.11b/g PCI"
	depends on ACX && PCI
	---help---
	Include PCI and CardBus support in acx.

	acx chipsets need their firmware loaded at startup.
	You will need to provide a firmware image via hotplug.

	Firmware may be in a form of single image 40-100kb in size
	(a 'combined' firmware) or two images - main image
	(again 40-100kb) and radio image (~10kb or less).

	Firmware images are requested from hotplug using following names:

	tiacx100 - main firmware image for acx100 chipset
	tiacx100rNN - radio acx100 firmware for radio type NN
	tiacx100cNN - combined acx100 firmware for radio type NN
	tiacx111 - main acx111 firmware
	tiacx111rNN - radio acx111 firmware for radio type NN
	tiacx111cNN - combined acx111 firmware for radio type NN

	Driver will attempt to load combined image first.
	If no such image is found, it will try to load main image
	and radio image instead.

	Firmware files are not covered by GPL and are not distributed
	with this driver for legal reasons.

config ACX_USB
	bool "TI acx100/acx111 802.11b/g USB"
	depends on ACX && (USB=y || USB=ACX)
	---help---
	Include USB support in acx.

	There is only one currently known device in this category,
	D-Link DWL-120+, but newer devices seem to be on the horizon.

	acx chipsets need their firmware loaded at startup.
	You will need to provide a firmware image via hotplug.

	Firmware for USB device is requested from hotplug
	by the 'tiacx100usb' name.

	Firmware files are not covered by GPL and are not distributed
	with this driver for legal reasons.
```

## backends/Kconfig
```kconfig
source tpm/Kconfig

config IOMMUFD
    bool
    depends on VFIO

config SPDM_SOCKET
    bool
    default y

config SPDM 
    bool 
    select SPDM_SOCKET
```

## backends/tpm/Kconfig
```kconfig
config TPM_BACKEND
    bool
    depends on TPM

config TPM_PASSTHROUGH
    bool
    default y
    # FIXME: should check for x86 host as well
    depends on TPM_BACKEND && LINUX

config TPM_EMULATOR
    bool
    default y
    depends on TPM_BACKEND
```

## dump/Kconfig
```kconfig
# SPDX-License-Identifier: GPL-2.0-or-later

config WINDUMP
    bool
    default y if X86_64
    depends on X86_64
```

## hw/9pfs/Kconfig
```kconfig
config FSDEV_9P
    bool
    depends on VIRTFS

config 9PFS
    bool

config VIRTIO_9P
    bool
    default y
    depends on VIRTFS && VIRTIO
    select FSDEV_9P
    select 9PFS
```

## hw/Kconfig
```kconfig
# devices Kconfig
source 9pfs/Kconfig
source acpi/Kconfig
source adc/Kconfig
source audio/Kconfig
source block/Kconfig
source char/Kconfig
source core/Kconfig
source cxl/Kconfig
source display/Kconfig
source dma/Kconfig
source gpio/Kconfig
source hyperv/Kconfig
source i2c/Kconfig
source ide/Kconfig
source input/Kconfig
source intc/Kconfig
source ipack/Kconfig
source ipmi/Kconfig
source isa/Kconfig
source mem/Kconfig
source misc/Kconfig
source net/Kconfig
source nubus/Kconfig
source nvme/Kconfig
source nvram/Kconfig
source pci-bridge/Kconfig
source pci-host/Kconfig
source pcmcia/Kconfig
source pci/Kconfig
source rdma/Kconfig
source remote/Kconfig
source rtc/Kconfig
source scsi/Kconfig
source sd/Kconfig
source sensor/Kconfig
source smbios/Kconfig
source ssi/Kconfig
source timer/Kconfig
source tpm/Kconfig
source usb/Kconfig
source virtio/Kconfig
source vfio/Kconfig
source watchdog/Kconfig

# arch Kconfig
source arm/Kconfig
source alpha/Kconfig
source avr/Kconfig
source cris/Kconfig
source hppa/Kconfig
source i386/Kconfig
source loongarch/Kconfig
source m68k/Kconfig
source microblaze/Kconfig
source mips/Kconfig
source nios2/Kconfig
source openrisc/Kconfig
source ppc/Kconfig
source riscv/Kconfig
source rx/Kconfig
source s390x/Kconfig
source sh4/Kconfig
source sparc/Kconfig
source sparc64/Kconfig
source tricore/Kconfig
source xtensa/Kconfig

# Symbols used by multiple targets
config TEST_DEVICES
    bool

config XILINX
    bool
    select PTIMER # for hw/timer/xilinx_timer.c

config XILINX_AXI
    bool
    select PTIMER # for hw/dma/xilinx_axidma.c

config XLNX_ZYNQMP
    bool
    select REGISTER
    select CAN_BUS
    select PTIMER
    select XLNX_BBRAM
    select XLNX_EFUSE_ZYNQMP
```

## hw/acpi/Kconfig
```kconfig
config ACPI
    bool

config ACPI_X86
    bool
    select ACPI
    select ACPI_NVDIMM
    select ACPI_CXL
    select ACPI_CPU_HOTPLUG
    select ACPI_MEMORY_HOTPLUG
    select ACPI_HMAT
    select ACPI_PCIHP
    select ACPI_ERST

config ACPI_ICH9
    bool
    select ACPI_SMBUS
    select ACPI_X86
    select APM

config ACPI_CPU_HOTPLUG
    bool

config ACPI_MEMORY_HOTPLUG
    bool
    select MEM_DEVICE

config ACPI_NVDIMM
    bool
    depends on ACPI

config ACPI_PIIX4
    bool
    select ACPI
    select ACPI_SMBUS
    select APM

config ACPI_PCIHP
    bool
    depends on ACPI

config ACPI_PCI_BRIDGE
    bool
    depends on ACPI && PCI && ACPI_PCIHP

config ACPI_HMAT
    bool
    depends on ACPI

config ACPI_APEI
    bool
    depends on ACPI

config ACPI_PCI
    bool
    depends on ACPI && PCI

config ACPI_VMGENID
    bool
    default y
    depends on PC

config ACPI_VMCLOCK
    bool
    default y
    depends on PC

config ACPI_VIOT
    bool
    depends on ACPI

config ACPI_HW_REDUCED
    bool
    select ACPI
    select ACPI_MEMORY_HOTPLUG
    select ACPI_NVDIMM

config ACPI_ERST
    bool
    default y
    depends on ACPI && PCI

config ACPI_CXL
    bool
    depends on ACPI
```

## hw/alpha/Kconfig
```kconfig
config DP264
    bool
    imply PCI_DEVICES
    imply TEST_DEVICES
    imply E1000_PCI
    select I82378
    select IDE_CMD646
    select MC146818RTC
    select PCI
    select PCKBD
    select SMC37C669
```

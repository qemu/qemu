## hw/nvme/Kconfig
```kconfig
config NVME_PCI
    bool
    default y if PCI_DEVICES || PCIE_DEVICES
    depends on PCI
```

## hw/nvram/Kconfig
```kconfig
config DS1225Y
    bool

config AT24C
    bool
    depends on I2C

config MAC_NVRAM
    bool
    select CHRP_NVRAM

# NMC93XX uses the NS uWire interface (similar to SPI but less configurable)
config NMC93XX_EEPROM
    bool

config CHRP_NVRAM
    bool

config XLNX_EFUSE_CRC
    bool

config XLNX_EFUSE
    bool
    select XLNX_EFUSE_CRC

config XLNX_EFUSE_VERSAL
    bool
    select XLNX_EFUSE

config XLNX_EFUSE_ZYNQMP
    bool
    select XLNX_EFUSE

config XLNX_BBRAM
    bool
    select XLNX_EFUSE_CRC
```

## hw/openrisc/Kconfig
```kconfig
config OR1K_SIM
    bool
    default y
    depends on OPENRISC
    select DEVICE_TREE
    select SERIAL_MM
    select OPENCORES_ETH
    select OMPIC
    select SPLIT_IRQ

config OR1K_VIRT
    bool
    default y
    depends on OPENRISC
    imply PCI_DEVICES
    imply VIRTIO_VGA
    imply TEST_DEVICES
    select DEVICE_TREE
    select PCI
    select PCI_EXPRESS_GENERIC_BRIDGE
    select GOLDFISH_RTC
    select SERIAL_MM
    select SIFIVE_TEST
    select VIRTIO_MMIO
```

## hw/pci-bridge/Kconfig
```kconfig
config PCIE_PORT
    bool
    default y if PCI_DEVICES
    depends on PCI_EXPRESS && MSI_NONBROKEN

config PCIE_PCI_BRIDGE
    bool
    default y if PCIE_PORT
    depends on PCIE_PORT

config PXB
    bool
    default y if Q35 || ARM_VIRT

config XIO3130
    bool
    default y if PCI_DEVICES
    depends on PCI_EXPRESS && MSI_NONBROKEN

config IOH3420
    bool
    default y if PCI_DEVICES
    depends on PCI_EXPRESS && MSI_NONBROKEN

config I82801B11
    bool
    default y if PCI_DEVICES
    depends on PCI_EXPRESS

config DEC_PCI
    bool

config SIMBA
    bool

config CXL
    bool
    default y if PCI_EXPRESS && PXB
    depends on PCI_EXPRESS && MSI_NONBROKEN && PXB
```

## hw/pci-host/Kconfig
```kconfig
config PAM
    bool

config XEN_IGD_PASSTHROUGH
    bool
    default y
    depends on XEN && PCI_I440FX

config PPC4XX_PCI
    bool
    select PCI

config PPC440_PCIX
    bool
    select PCI

config RAVEN_PCI
    bool
    select PCI
    select OR_IRQ

config GRACKLE_PCI
    select PCI
    bool

config UNIN_PCI
    bool
    select PCI
    select DEC_PCI
    select OPENPIC

config PPCE500_PCI
    select PCI
    bool

config VERSATILE_PCI
    select PCI
    bool

config PCI_SABRE
    select PCI
    bool

config PCI_I440FX
    bool
    select PCI
    select PAM

config PCI_EXPRESS_Q35
    bool
    select PCI_EXPRESS
    select PAM

config PCI_EXPRESS_GENERIC_BRIDGE
    bool
    select PCI_EXPRESS

config PCI_EXPRESS_XILINX
    bool
    select PCI_EXPRESS

config PCI_EXPRESS_DESIGNWARE
    bool
    select PCI_EXPRESS
    select MSI_NONBROKEN

config PCI_BONITO
    select PCI
    select UNIMP
    bool

config PCI_POWERNV
    select PCI_EXPRESS
    select MSI_NONBROKEN
    select PCIE_PORT

config REMOTE_PCIHOST
    bool

config SH_PCI
    bool
    select PCI

config ARTICIA
    bool
    select PCI
    select I8259

config MV64361
    bool
    select PCI
    select I8259

config DINO
    bool
    select PCI

config ASTRO
    bool
    select PCI

config PCI_EXPRESS_FSL_IMX8M_PHY
    bool

config GT64120
    bool
    select PCI
    select EMPTY_SLOT
    select I8259
```

## hw/pci/Kconfig
```kconfig
config PCI
    bool

config PCI_EXPRESS
    bool
    select PCI

config PCI_DEVICES
    bool

config PCIE_DEVICES
    bool

config MSI_NONBROKEN
    # selected by interrupt controllers that do not support MSI,
    # or support it and have a good implementation. See commit
    # 47d2b0f33c664533b8dbd5cb17faa8e6a01afe1f.
    bool
```

## hw/ppc/Kconfig
```kconfig
config PSERIES
    bool
    default y
    depends on PPC64 && FDT
    imply USB_OHCI_PCI
    imply PCI_DEVICES
    imply TEST_DEVICES
    imply VIRTIO_VGA
    imply VFIO_PCI if LINUX   # needed by spapr_pci_vfio.c
    select NVDIMM
    select DIMM
    select PCI
    select SPAPR_VSCSI
    select XICS
    select XIVE
    select MSI_NONBROKEN
    select FDT_PPC
    select CHRP_NVRAM
    select VOF

config SPAPR_RNG
    bool
    default y
    depends on PSERIES

config POWERNV
    bool
    default y
    depends on PPC64 && FDT
    imply PCI_DEVICES
    imply TEST_DEVICES
    select ISA_IPMI_BT
    select IPMI_LOCAL
    select ISA_BUS
    select MC146818RTC
    select XICS
    select XIVE
    select FDT_PPC
    select PCI_POWERNV
    select PCA9552
    select PCA9554
    select SERIAL_ISA
    select SSI
    select SSI_M25P80
    select PNV_SPI

config PPC405
    bool
    default y
    depends on PPC

config PPC440
    bool
    default y
    depends on PPC && FDT
    imply PCI_DEVICES
    imply TEST_DEVICES
    imply E1000_PCI
    select PCI_EXPRESS
    select PPC440_PCIX
    select PPC4XX
    select SERIAL_MM
    select FDT_PPC

config PPC4XX
    bool
    select BITBANG_I2C
    select PPC4XX_PCI
    select PPC_UIC

config SAM460EX
    bool
    default y
    depends on PPC && FDT
    select PFLASH_CFI01
    select IDE_SII3112
    select M41T80
    select PPC440
    select SERIAL_MM
    select SM501
    select SMBUS_EEPROM
    select USB_EHCI_SYSBUS
    select USB_OHCI_SYSBUS
    select FDT_PPC

config AMIGAONE
    bool
    default y
    depends on PPC
    imply ATI_VGA
    select ARTICIA
    select VT82C686
    select SMBUS_EEPROM

config PEGASOS
    bool
    default y
    depends on PPC
    imply ATI_VGA
    select MV64361
    select VT82C686
    select SMBUS_EEPROM
    select VOF

config PREP
    bool
    default y
    depends on PPC
    imply PCI_DEVICES
    imply TEST_DEVICES
    select CS4231A
    select RAVEN_PCI
    select I82378
    select LSI_SCSI_PCI
    select M48T59
    select PC87312
    select RS6000_MC
    select FW_CFG_PPC

config RS6000_MC
    bool

config MAC_OLDWORLD
    bool
    default y
    depends on PPC
    imply PCI_DEVICES
    imply SUNGEM
    imply TEST_DEVICES
    select ADB
    select GRACKLE_PCI
    select HEATHROW_PIC
    select MACIO
    select FW_CFG_PPC

config MAC_NEWWORLD
    bool
    default y
    depends on PPC
    imply PCI_DEVICES
    imply SUNGEM
    imply TEST_DEVICES
    imply USB_OHCI_PCI
    select ADB
    select MACIO
    select MACIO_GPIO
    select MAC_PMU
    select UNIN_PCI
    select FW_CFG_PPC

config E500
    bool
    imply AT24C
    imply VIRTIO_PCI
    select ETSEC
    select GPIO_MPC8XXX
    select OPENPIC
    select PFLASH_CFI01
    select PLATFORM_BUS
    select PPCE500_PCI
    select SDHCI
    select SERIAL_MM
    select MPC_I2C
    select FDT_PPC
    select DS1338
    select UNIMP

config E500PLAT
    bool
    default y
    depends on PPC && FDT
    select E500

config MPC8544DS
    bool
    default y
    depends on PPC && FDT
    select E500

config VIRTEX
    bool
    default y
    depends on PPC && FDT
    select PPC4XX
    select PFLASH_CFI01
    select SERIAL_MM
    select XILINX
    select XILINX_ETHLITE
    select FDT_PPC

# Only used by 64-bit targets
config FW_CFG_PPC
    bool

config FDT_PPC
    select DEVICE_TREE
    bool

config VOF
    bool
```

## hw/rdma/Kconfig
```kconfig
config VMW_PVRDMA
    default y if PCI_DEVICES
    depends on PVRDMA && MSI_NONBROKEN && VMXNET3_PCI
```

## hw/remote/Kconfig
```kconfig
config MULTIPROCESS
    bool
    depends on PCI && PCI_EXPRESS && KVM
    select REMOTE_PCIHOST
```

## hw/riscv/Kconfig
```kconfig
config RISCV_IOMMU
    bool

config RISCV_NUMA
    bool

config IBEX
    bool

# RISC-V machines in alphabetical order

config MICROCHIP_PFSOC
    bool
    default y
    depends on RISCV64
    select CADENCE_SDHCI
    select CPU_CLUSTER
    select DEVICE_TREE
    select MCHP_PFSOC_DMC
    select MCHP_PFSOC_IOSCB
    select MCHP_PFSOC_MMUART
    select MCHP_PFSOC_SYSREG
    select RISCV_ACLINT
    select SIFIVE_PDMA
    select SIFIVE_PLIC
    select UNIMP

config MICROBLAZE_V
    bool
    default y
    depends on RISCV32 || RISCV64
    select XILINX
    select XILINX_AXI
    select XILINX_ETHLITE

config OPENTITAN
    bool
    default y
    depends on RISCV32
    select IBEX
    select SIFIVE_PLIC
    select UNIMP

config RISCV_VIRT
    bool
    default y
    depends on RISCV32 || RISCV64
    imply PCI_DEVICES
    imply VIRTIO_VGA
    imply TEST_DEVICES
    imply TPM_TIS_SYSBUS
    select DEVICE_TREE
    select RISCV_NUMA
    select GOLDFISH_RTC
    select PCI
    select PCI_EXPRESS_GENERIC_BRIDGE
    select PFLASH_CFI01
    select SERIAL_MM
    select RISCV_ACLINT
    select RISCV_APLIC
    select RISCV_IOMMU
    select RISCV_IMSIC
    select SIFIVE_PLIC
    select SIFIVE_TEST
    select SMBIOS
    select VIRTIO_MMIO
    select FW_CFG_DMA
    select PLATFORM_BUS
    select ACPI
    select ACPI_PCI

config SHAKTI_C
    bool
    default y
    depends on RISCV64
    select RISCV_ACLINT
    select SHAKTI_UART
    select SIFIVE_PLIC
    select UNIMP

config SIFIVE_E
    bool
    default y
    depends on RISCV32 || RISCV64
    select RISCV_ACLINT
    select SIFIVE_GPIO
    select SIFIVE_PLIC
    select SIFIVE_UART
    select SIFIVE_E_PRCI
    select SIFIVE_E_AON
    select UNIMP

config SIFIVE_U
    bool
    default y
    depends on RISCV32 || RISCV64
    select CADENCE
    select CPU_CLUSTER
    select DEVICE_TREE
    select RISCV_ACLINT
    select SIFIVE_GPIO
    select SIFIVE_PDMA
    select SIFIVE_PLIC
    select SIFIVE_SPI
    select SIFIVE_UART
    select SIFIVE_U_OTP
    select SIFIVE_U_PRCI
    select SIFIVE_PWM
    select SSI_M25P80
    select SSI_SD
    select UNIMP

config SPIKE
    bool
    default y
    depends on RISCV32 || RISCV64
    select DEVICE_TREE
    select RISCV_NUMA
    select HTIF
    select RISCV_ACLINT
    select SIFIVE_PLIC

config XIANGSHAN_KUNMINGHU
    bool
    default y
    depends on RISCV64
    select RISCV_ACLINT
    select RISCV_APLIC
    select RISCV_IMSIC
    select SERIAL_MM
```

## hw/rtc/Kconfig
```kconfig
config DS1338
    bool
    depends on I2C
    default y if I2C_DEVICES

config M41T80
    bool
    depends on I2C
    default y if I2C_DEVICES

config M48T59
    bool

config PL031
    bool

config MC146818RTC
    depends on ISA_BUS
    bool

config SUN4V_RTC
    bool

config GOLDFISH_RTC
    bool

config LS7A_RTC
    bool

config RS5C372_RTC
    bool
    depends on I2C
    default y if I2C_DEVICES
```

## hw/rx/Kconfig
```kconfig
config RX62N_MCU
    bool
    select RX_ICU
    select RENESAS_TMR
    select RENESAS_CMT
    select RENESAS_SCI

config RX_GDBSIM
    bool
    default y
    depends on RX && FDT
    select DEVICE_TREE
    select RX62N_MCU
```

## hw/s390x/Kconfig
```kconfig
config S390_CCW_VIRTIO
    bool
    default y
    depends on S390X
    imply VIRTIO_PCI
    imply TERMINAL3270
    imply VFIO_AP
    imply VFIO_CCW
    imply WDT_DIAG288
    imply PCI_BRIDGE
    imply PCIE_DEVICES
    imply IOMMUFD
    select PCI_EXPRESS
    select S390_FLIC
    select S390_FLIC_KVM if KVM
    select SCLPCONSOLE
    select VIRTIO_CCW
    select MSI_NONBROKEN
    select VIRTIO_MEM_SUPPORTED
```

## hw/scsi/Kconfig
```kconfig
config SCSI
    bool

config LSI_SCSI_PCI
    bool
    default y if PCI_DEVICES
    depends on PCI
    select SCSI

config MPTSAS_SCSI_PCI
    bool
    default y if PCI_DEVICES
    depends on PCI
    select SCSI

config MEGASAS_SCSI_PCI
    bool
    default y if PCI_DEVICES
    depends on PCI
    select SCSI

config VMW_PVSCSI_SCSI_PCI
    bool
    default y if PCI_DEVICES
    depends on PCI
    select SCSI

config ESP
    bool
    select SCSI

config ESP_PCI
    bool
    default y if PCI_DEVICES
    depends on PCI
    select ESP
    select NMC93XX_EEPROM

config SPAPR_VSCSI
    bool
    default y
    depends on PSERIES
    select SCSI

config VIRTIO_SCSI
    bool
    default y
    depends on VIRTIO
    select SCSI

config VHOST_SCSI_COMMON
    bool
    depends on VIRTIO

config VHOST_SCSI
    bool
    default y
    select VHOST_SCSI_COMMON
    depends on VIRTIO && VHOST_KERNEL

config VHOST_USER_SCSI
    bool
    # Only PCI devices are provided for now
    default y if VIRTIO_PCI
    select VHOST_SCSI_COMMON
    depends on VIRTIO && VHOST_USER && LINUX
```

## hw/sd/Kconfig
```kconfig
config PL181
    bool
    select SD

config SSI_SD
    bool
    depends on SSI
    select SD

config SD
    bool

config SDHCI
    bool
    select SD

config SDHCI_PCI
    bool
    default y if PCI_DEVICES
    depends on PCI
    select SDHCI
```

## hw/semihosting/Kconfig
```kconfig
config SEMIHOSTING
       bool

config ARM_COMPATIBLE_SEMIHOSTING
       bool
       select SEMIHOSTING
```

## hw/sensor/Kconfig
```kconfig
config TMP105
    bool
    depends on I2C
    default y if I2C_DEVICES

config TMP421
    bool
    depends on I2C
    default y if I2C_DEVICES

config DPS310
    bool
    depends on I2C
    default y if I2C_DEVICES

config EMC141X
    bool
    depends on I2C
    default y if I2C_DEVICES

config ADM1272
    bool
    depends on I2C

config MAX34451
    bool
    depends on I2C

config LSM303DLHC_MAG
    bool
    depends on I2C
    default y if I2C_DEVICES

config ISL_PMBUS_VR
    bool
    depends on PMBUS

config MAX31785
    bool
    depends on PMBUS
```

## hw/sh4/Kconfig
```kconfig
config R2D
    bool
    default y
    depends on SH4
    imply PCI_DEVICES
    imply TEST_DEVICES
    imply RTL8139_PCI
    select I82378 if TEST_DEVICES
    select IDE_MMIO
    select PFLASH_CFI02
    select PCI
    select SM501
    select SH7750
    select SH_PCI

config SH7750
    bool
    select SH_INTC
    select SH_SCI
    select SH_TIMER
```

## hw/sparc/Kconfig
```kconfig
config SUN4M
    bool
    default y
    depends on SPARC && !SPARC64
    imply TCX
    imply CG3
    select CS4231
    select ECCMEMCTL
    select EMPTY_SLOT
    select UNIMP
    select ESCC
    select ESP
    select FDC_SYSBUS
    select SLAVIO
    select LANCE
    select M48T59
    select STP2000
    select CHRP_NVRAM
    select OR_IRQ

config LEON3
    bool
    default y
    depends on SPARC && !SPARC64
    select GRLIB

config GRLIB
    bool
    select PTIMER

config SLAVIO
    bool
    select PTIMER
```

## hw/sparc64/Kconfig
```kconfig
config SUN4U
    bool
    default y
    depends on SPARC64
    imply PCI_DEVICES
    imply SUNHME
    imply TEST_DEVICES
    imply PARALLEL
    select M48T59
    select ISA_BUS
    select FDC_ISA
    select SERIAL_ISA
    select SERIAL_MM
    select PCI_SABRE
    select IDE_CMD646
    select PCKBD
    select SIMBA
    select CHRP_NVRAM

config NIAGARA
    bool
    default y
    depends on SPARC64
    select EMPTY_SLOT
    select SUN4V_RTC
    select UNIMP
```

## hw/ssi/Kconfig
```kconfig
config PL022
    bool
    select SSI

config SIFIVE_SPI
    bool
    select SSI

config SSI
    bool

config XILINX_SPI
    bool
    select SSI

config XILINX_SPIPS
    bool
    select SSI

config STM32F2XX_SPI
    bool
    select SSI
```

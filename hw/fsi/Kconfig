## hw/misc/Kconfig
```kconfig
config APPLESMC
    bool
    depends on ISA_BUS

config ARMSSE_CPUID
    bool

config ARMSSE_MHU
    bool

config ARMSSE_CPU_PWRCTRL
    bool

config ISA_DEBUG
    bool
    depends on ISA_BUS

config ISA_TESTDEV
    bool
    default y if TEST_DEVICES
    depends on ISA_BUS

config PCI_TESTDEV
    bool
    default y if TEST_DEVICES
    depends on PCI

config EDU
    bool
    default y if TEST_DEVICES
    depends on PCI && MSI_NONBROKEN

config I2C_ECHO
    bool
    default y if TEST_DEVICES
    depends on I2C

config PL310
    bool

config INTEGRATOR_DEBUG
    bool

config A9SCU
    bool

config ARM11SCU
    bool

config MAX78000_AES
    bool

config MAX78000_GCR
    bool

config MAX78000_ICC
    bool

config MAX78000_TRNG
    bool

config MOS6522
    bool

config MACIO
    bool
    select CUDA
    select ESCC
    select IDE_MACIO
    select MAC_DBDMA
    select MAC_NVRAM
    select MOS6522

config IVSHMEM_DEVICE
    bool
    default y if PCI_DEVICES
    depends on PCI && LINUX && IVSHMEM && MSI_NONBROKEN

config IVSHMEM_FLAT_DEVICE
    bool
    default y
    depends on LINUX && IVSHMEM

config ECCMEMCTL
    bool

config IMX
    bool
    select PTIMER
    select SSI
    select USB_EHCI_SYSBUS

config FSL_IMX8MP_ANALOG
    bool

config FSL_IMX8MP_CCM
    bool

config STM32_RCC
    bool

config STM32F2XX_SYSCFG
    bool

config STM32F4XX_SYSCFG
    bool

config STM32F4XX_EXTI
    bool

config STM32L4X5_EXTI
    bool

config STM32L4X5_SYSCFG
    bool

config STM32L4X5_RCC
    bool

config MIPS_ITU
    bool
    depends on TCG

config MPS2_FPGAIO
    bool
    select LED

config MPS2_SCC
    bool
    select LED

config TZ_MPC
    bool

config TZ_MSC
    bool

config TZ_PPC
    bool

config IOTKIT_SECCTL
    bool

config IOTKIT_SYSCTL
    bool

config IOTKIT_SYSINFO
    bool

config PVPANIC_COMMON
    bool

config PVPANIC_PCI
    bool
    default y if PCI_DEVICES
    depends on PCI
    select PVPANIC_COMMON

config PVPANIC_ISA
    bool
    depends on ISA_BUS
    select PVPANIC_COMMON

config PVPANIC_MMIO
    bool
    select PVPANIC_COMMON

config AUX
    bool
    select I2C

config UNIMP
    bool

config LED
    bool

config MAC_VIA
    bool
    select MOS6522
    select ADB

config AVR_POWER
    bool

config MCHP_PFSOC_DMC
    bool

config MCHP_PFSOC_IOSCB
    bool

config MCHP_PFSOC_SYSREG
    bool

config SIFIVE_TEST
    bool

config SIFIVE_E_PRCI
    bool

config SIFIVE_E_AON
    bool

config SIFIVE_U_OTP
    bool

config SIFIVE_U_PRCI
    bool

config VIRT_CTRL
    bool

config LASI
    bool

config ALLWINNER_SRAMC
    bool

config ALLWINNER_A10_CCM
    bool

config ALLWINNER_A10_DRAMC
    bool

config AXP2XX_PMU
    bool
    depends on I2C

config DJMEMC
    bool

config IOSB
    bool

config XLNX_VERSAL_TRNG
    bool

source macio/Kconfig
```

## hw/misc/macio/Kconfig
```kconfig
config CUDA
    bool

config MAC_PMU
    bool

config MAC_DBDMA
    bool

config MACIO_GPIO
    bool
```

## hw/net/Kconfig
```kconfig
config DP8393X
    bool

config NE2000_COMMON
    bool

config NE2000_PCI
    bool
    default y if PCI_DEVICES
    depends on PCI
    select NE2000_COMMON

config EEPRO100_PCI
    bool
    default y if PCI_DEVICES
    depends on PCI
    select NMC93XX_EEPROM

config PCNET_PCI
    bool
    default y if PCI_DEVICES
    depends on PCI
    select PCNET_COMMON

config PCNET_COMMON
    bool

config TULIP
    bool
    default y if PCI_DEVICES
    depends on PCI
    select NMC93XX_EEPROM

config I82596_COMMON
    bool

config E1000_PCI
    bool
    default y if PCI_DEVICES
    depends on PCI

config E1000E_PCI_EXPRESS
    bool
    default y if PCI_DEVICES || PCIE_DEVICES
    depends on PCI_EXPRESS && MSI_NONBROKEN

config IGB_PCI_EXPRESS
    bool
    default y if PCI_DEVICES || PCIE_DEVICES
    depends on PCI_EXPRESS && MSI_NONBROKEN

config RTL8139_PCI
    bool
    default y if PCI_DEVICES
    depends on PCI

config VMXNET3_PCI
    bool
    default y if PCI_DEVICES
    depends on PCI

config SMC91C111
    bool

config LAN9118
    bool
    select PTIMER

config NE2000_ISA
    bool
    default y
    depends on ISA_BUS
    select NE2000_COMMON

config OPENCORES_ETH
    bool

config XGMAC
    bool

config MIPSNET
    bool

config ALLWINNER_EMAC
    bool

config ALLWINNER_SUN8I_EMAC
    bool

config IMX_FEC
    bool

config CADENCE
    bool

config STELLARIS_ENET
    bool

config LANCE
    bool
    select PCNET_COMMON

config LASI_82596
    bool
    select I82596_COMMON

config SUNHME
    bool

config FTGMAC100
    bool

config SUNGEM
    bool
    depends on PCI

config COLDFIRE
    bool

config XILINX_ETHLITE
    bool

config VIRTIO_NET
    bool
    default y
    depends on VIRTIO

config ETSEC
    bool
    select PTIMER

config ROCKER
    bool
    default y if PCI_DEVICES
    depends on PCI && MSI_NONBROKEN

config CAN_BUS
    bool

config CAN_SJA1000
    bool
    default y if PCI_DEVICES
    select CAN_BUS

config CAN_PCI
    bool
    default y if PCI_DEVICES
    depends on PCI && CAN_SJA1000
    select CAN_BUS

config CAN_CTUCANFD
    bool
    default y if PCI_DEVICES
    select CAN_BUS

config CAN_CTUCANFD_PCI
    bool
    default y if PCI_DEVICES
    depends on PCI && CAN_CTUCANFD
    select CAN_BUS
```

## hw/nios2/Kconfig
```kconfig
config NIOS2_10M50
    bool
    select NIOS2
    select SERIAL
    select ALTERA_TIMER
    select NIOS2_VIC

config NIOS2_GENERIC_NOMMU
    bool
    select NIOS2

config NIOS2
    bool
```

## hw/nitro/Kconfig
```kconfig
config NITRO_VSOCK_BUS
    bool

config NITRO_SERIAL_VSOCK
    bool
    depends on NITRO_VSOCK_BUS

config NITRO_HEARTBEAT
    bool
    depends on NITRO_VSOCK_BUS

config NITRO_MACHINE
    bool
    default y
    depends on NITRO
    select NITRO_VSOCK_BUS
    select NITRO_HEARTBEAT
    select NITRO_SERIAL_VSOCK
```

## hw/fsi/Kconfig
```kconfig
config FSI_APB2OPB_ASPEED
    bool
    depends on ASPEED_SOC
    select FSI

config FSI
    bool
```

## hw/gpio/Kconfig
```kconfig
config PL061
    bool

config GPIO_KEY
    bool

config GPIO_MPC8XXX
    bool

config GPIO_PWR
    bool

config SIFIVE_GPIO
    bool

config STM32L4X5_GPIO
    bool

config PCA9552
    bool
    depends on I2C

config PCA9554
    bool
    depends on I2C

config PCF8574
    bool
    depends on I2C

config ZAURUS_SCOOP
    bool
```

## hw/hppa/Kconfig
```kconfig
config HPPA_B160L
    bool
    default y
    depends on HPPA
    imply PCI_DEVICES
    imply E1000_PCI
    imply USB_OHCI_PCI
    imply VIRTIO_VGA
    select ASTRO
    select DINO
    select LASI
    select SERIAL_MM
    select SERIAL_PCI
    select DIVA_GSP
    select ISA_BUS
    select I8259
    select IDE_CMD646
    select MC146818RTC
    select LSI_SCSI_PCI
    select PARALLEL
    select ARTIST
```

## hw/hyperv/Kconfig
```kconfig
config HYPERV
    bool
    depends on KVM

config HYPERV_TESTDEV
    bool
    default y if TEST_DEVICES
    depends on HYPERV

config VMBUS
    bool
    default y
    depends on HYPERV

config SYNDBG
    bool
    default y
    depends on VMBUS

config HV_BALLOON_SUPPORTED
    bool

config HV_BALLOON
    bool
    default y
    depends on VMBUS
    depends on HV_BALLOON_POSSIBLE
    depends on HV_BALLOON_SUPPORTED
```

## hw/i2c/Kconfig
```kconfig
config I2C
    bool

config I2C_DEVICES
    # Device group for i2c devices which can reasonably be user-plugged
    # to any board's i2c bus
    bool

config SMBUS
    bool
    select I2C

config SMBUS_EEPROM
    bool
    select SMBUS

config ARM_SBCON_I2C
    bool
    select BITBANG_I2C

config ACPI_SMBUS
    bool
    select SMBUS

config BITBANG_I2C
    bool
    select I2C

config IMX_I2C
    bool
    select I2C

config MPC_I2C
    bool
    select I2C

config ALLWINNER_I2C
    bool
    select I2C

config PCA954X
    bool
    select I2C

config PMBUS
    bool
    select SMBUS
```

## hw/i386/Kconfig
```kconfig
config X86_FW_OVMF
    bool

config SEV
    bool
    select X86_FW_OVMF
    depends on KVM

config SGX
    bool
    depends on KVM

config PC
    bool
    imply APPLESMC
    imply HYPERV
    imply ISA_IPMI_KCS
    imply ISA_IPMI_BT
    imply PCI_IPMI_KCS
    imply PCI_IPMI_BT
    imply IPMI_SSIF
    imply ISA_DEBUG
    imply PARALLEL
    imply PCI_DEVICES
    imply PVPANIC_ISA
    imply QXL
    imply SEV
    imply SGX
    imply TEST_DEVICES
    imply TPM_CRB
    imply TPM_TIS_ISA
    imply VGA_PCI
    imply VIRTIO_VGA
    imply NVDIMM
    select FDC_ISA
    select I8259
    select I8254
    select PCKBD
    select PCSPK
    select I8257
    select MC146818RTC
    # For ACPI builder:
    select SERIAL_ISA
    select ACPI_PCI
    select ACPI_VMGENID
    select VIRTIO_PMEM_SUPPORTED
    select VIRTIO_MEM_SUPPORTED
    select HV_BALLOON_SUPPORTED

config PC_PCI
    bool
    select APIC
    select IOAPIC
    select PC

config PC_ACPI
    bool
    select ACPI_X86
    select ACPI_CPU_HOTPLUG
    select ACPI_MEMORY_HOTPLUG
    select ACPI_PCI_BRIDGE
    select ACPI_VIOT
    select SMBUS_EEPROM
    select PFLASH_CFI01
    depends on ACPI_SMBUS

config I440FX
    bool
    imply E1000_PCI
    imply VMPORT
    imply VMMOUSE
    select ACPI_PIIX4
    select PC_PCI
    select PC_ACPI
    select PCI_I440FX
    select PIIX
    select DIMM
    select SMBIOS
    select FW_CFG_DMA

config ISAPC
    bool
    imply VGA_ISA
    select ISA_BUS
    select PC
    select IDE_ISA
    # FIXME: it is in the same file as i440fx, and does not compile
    # if separated
    depends on I440FX

config Q35
    bool
    imply VTD
    imply AMD_IOMMU
    imply E1000E_PCI_EXPRESS
    imply VMPORT
    imply VMMOUSE
    select PC_PCI
    select PC_ACPI
    select PCI_EXPRESS_Q35
    select LPC_ICH9
    select AHCI_ICH9
    select DIMM
    select SMBIOS
    select FW_CFG_DMA

config MICROVM
    bool
    select SERIAL_ISA # for serial_hds_isa_init()
    select ISA_BUS
    select APIC
    select IOAPIC
    select I8259
    select MC146818RTC
    select VIRTIO_MMIO
    select ACPI_HW_REDUCED
    select PCI_EXPRESS_GENERIC_BRIDGE
    select USB_XHCI_SYSBUS
    select I8254

config X86_IOMMU
    bool
    depends on PC

config VTD
    bool
    select X86_IOMMU

config AMD_IOMMU
    bool
    select X86_IOMMU

config VMPORT
    bool

config VMMOUSE
    bool
    depends on VMPORT

config XEN_EMU
    bool
    default y
    depends on KVM && (I386 || X86_64)
```

## hw/i3c/Kconfig
```kconfig
config I3C
    bool

config DW_I3C
    bool

config I3C_DEVICES
    # Device group for i3c devices which can reasonably be user-plugged to any
    # board's i3c bus.
    bool

config MOCK_I3C_TARGET
    bool
    select I3C
    default y if I3C_DEVICES
```

## hw/ide/Kconfig
```kconfig
config IDE_CORE
    bool

config IDE_BUS
    bool
    select IDE_CORE

config IDE_DEV
    bool
    depends on IDE_BUS

config IDE_PCI
    bool
    depends on PCI
    select IDE_BUS
    select IDE_DEV

config IDE_ISA
    bool
    depends on ISA_BUS
    select IDE_BUS
    select IDE_DEV

config IDE_PIIX
    bool
    select IDE_PCI

config IDE_CMD646
    bool
    select IDE_PCI

config IDE_MACIO
    bool
    select IDE_BUS
    select IDE_DEV

config IDE_MMIO
    bool
    select IDE_BUS
    select IDE_DEV

config IDE_VIA
    bool
    select IDE_PCI

config MICRODRIVE
    bool
    select IDE_BUS
    select IDE_DEV
    depends on PCMCIA

config AHCI
    bool
    select IDE_BUS
    select IDE_DEV

config AHCI_ICH9
    bool
    default y if PCI_DEVICES
    depends on PCI
    select AHCI

config IDE_SII3112
    bool
    select IDE_PCI

config IDE_CF
    bool
    default y if IDE_BUS
```

## hw/input/Kconfig
```kconfig
config ADB
    bool

config PCKBD
    bool
    select PS2
    depends on ISA_BUS

config PL050
    bool
    select PS2

config PS2
    bool

config STELLARIS_GAMEPAD
    bool

config VIRTIO_INPUT
    bool
    default y
    depends on VIRTIO

config VIRTIO_INPUT_HOST
    bool
    default y
    depends on VIRTIO_INPUT && LINUX

config VHOST_USER_INPUT
    bool
    default y
    depends on VIRTIO_INPUT && VHOST_USER

config LASIPS2
    select PS2
```

## hw/intc/Kconfig
```kconfig
config HEATHROW_PIC
    bool

config I8259
    bool
    select ISA_BUS

config PL190
    bool

config IOAPIC
    bool
    select I8259

config ARM_GIC
    bool
    select MSI_NONBROKEN

config OPENPIC
    bool
    select MSI_NONBROKEN

config APIC
    bool
    select MSI_NONBROKEN
    select I8259

config ARM_GICV3_TCG
    bool
    default y
    depends on ARM_GIC && TCG

config ARM_GIC_KVM
    bool
    default y
    depends on ARM_GIC && KVM

config XICS
    bool

config XIVE
    bool

config ALLWINNER_A10_PIC
    bool

config S390_FLIC
    bool

config S390_FLIC_KVM
    bool
    depends on S390_FLIC && KVM

config OMPIC
    bool

config PPC_UIC
    bool

config SH_INTC
    bool

config RX_ICU
    bool

config LOONGSON_LIOINTC
    bool

config RISCV_ACLINT
    bool

config RISCV_APLIC
    bool
    select MSI_NONBROKEN

config RISCV_IMSIC
    bool
    select MSI_NONBROKEN

config SIFIVE_PLIC
    bool
    select MSI_NONBROKEN

config GOLDFISH_PIC
    bool

config M68K_IRQC
    bool

config NIOS2_VIC
    bool

config LOONGARCH_IPI
    bool

config LOONGARCH_PCH_PIC
    bool
    select UNIMP

config LOONGARCH_PCH_MSI
    select MSI_NONBROKEN
    bool
    select UNIMP

config LOONGARCH_EXTIOI
    bool
```

## hw/ipack/Kconfig
```kconfig
config IPACK
    bool

config TPCI200
    bool
    select IPACK
    default y if PCI_DEVICES
	    depends on PCI
```

## hw/ipmi/Kconfig
```kconfig
config IPMI
    bool

config IPMI_LOCAL
    bool
    default y
    depends on IPMI

config IPMI_EXTERN
    bool
    default y
    depends on IPMI

config ISA_IPMI_KCS
    bool
    depends on ISA_BUS
    select IPMI

config ISA_IPMI_BT
    bool
    depends on ISA_BUS
    select IPMI

config PCI_IPMI_KCS
    bool
    depends on PCI
    select IPMI

config PCI_IPMI_BT
    bool
    depends on PCI
    select IPMI

config IPMI_SSIF
    bool
    depends on I2C
    select IPMI
```

## hw/isa/Kconfig
```kconfig
config ISA_BUS
    bool

config APM
    bool

config I82378
    bool
    select ISA_BUS
    select I8259
    select I8254
    select I82374
    select MC146818RTC
    select PCSPK

config ISA_SUPERIO
    bool
    depends on ISA_BUS
    select PCKBD
    select PARALLEL
    select SERIAL_ISA
    select FDC_ISA
    # Some users of ISA_SUPERIO do not use it
    #select IDE_ISA

config FDC37M81X
    bool
    select ISA_SUPERIO

config PC87312
    bool
    select ISA_SUPERIO
    select I8259
    select I8254
    select I8257
    select MC146818RTC
    select IDE_ISA

config PIIX
    bool
    # For historical reasons, SuperIO devices are created in the board
    # for PIIX4.
    select ACPI_PIIX4
    select I8254
    select I8257
    select I8259
    select IDE_PIIX
    select ISA_BUS
    select MC146818RTC
    select USB_UHCI

config VT82C686
    bool
    select ISA_BUS
    select ISA_SUPERIO
    select ACPI
    select ACPI_SMBUS
    select USB_UHCI
    select APM
    select I8254
    select I8257
    select I8259
    select IDE_VIA
    select MC146818RTC

config SMC37C669
    bool
    select ISA_SUPERIO

config LPC_ICH9
    bool
    # For historical reasons, SuperIO devices are created in the board
    # for ICH9.
    select I8257
    select ISA_BUS
    select ACPI_ICH9
    select MC146818RTC
```

## hw/lm32/Kconfig
```kconfig
config LM32_DEVICES
    bool
    select PTIMER

config MILKYMIST
    bool
    # FIXME: disabling it results in compile-time errors
    select MILKYMIST_TMU2 if OPENGL && X11
    select PFLASH_CFI01
    select FRAMEBUFFER
    select SD
    select USB_OHCI
    select LM32_DEVICES

config LM32_EVR
    bool
    select LM32_DEVICES
    select PFLASH_CFI02
```

## hw/loongarch/Kconfig
```kconfig
config LOONGARCH_VIRT
    bool
    default y
    depends on LOONGARCH64 && FDT
    select DEVICE_TREE
    select PCI
    select PCI_EXPRESS_GENERIC_BRIDGE
    imply PCI_DEVICES
    imply NVDIMM
    imply TPM_TIS_SYSBUS
    select SERIAL_MM
    select VIRTIO_PCI
    select PLATFORM_BUS
    select LOONGARCH_IPI
    select LOONGARCH_PCH_PIC
    select LOONGARCH_PCH_MSI
    select LOONGARCH_EXTIOI
    select LS7A_RTC
    select SMBIOS
    select ACPI_CPU_HOTPLUG
    select ACPI_PCI
    select ACPI_HW_REDUCED
    select FW_CFG_DMA
    select DIMM
    select PFLASH_CFI01
    select ACPI_HMAT
```

## hw/m68k/Kconfig
```kconfig
config AN5206
    bool
    select COLDFIRE
    select PTIMER

config MCF5208
    bool
    select COLDFIRE
    select PTIMER

config NEXTCUBE
    bool
    select FRAMEBUFFER
    select ESCC

config Q800
    bool
    select MAC_VIA
    select NUBUS
    select MACFB
    select SWIM
    select ESCC
    select ESP
    select DP8393X
    select OR_IRQ
    select DJMEMC
    select IOSB
    select ASC

config M68K_VIRT
    bool
    select M68K_IRQC
    select VIRT_CTRL
    select GOLDFISH_PIC
    select GOLDFISH_TTY
    select GOLDFISH_RTC
    select VIRTIO_MMIO
```

## hw/mem/Kconfig
```kconfig
config DIMM
    bool
    select MEM_DEVICE

config MEM_DEVICE
    bool

config NVDIMM
    bool
    select MEM_DEVICE

config SPARSE_MEM
    bool

config CXL_MEM_DEVICE
    bool
    default y if CXL
    select MEM_DEVICE
```

## hw/microblaze/Kconfig
```kconfig
config PETALOGIX_S3ADSP1800
    bool
    default y
    depends on MICROBLAZE && FDT
    select PFLASH_CFI01
    select XILINX
    select XILINX_AXI
    select XILINX_ETHLITE
    select UNIMP

config PETALOGIX_ML605
    bool
    default y
    depends on MICROBLAZE && FDT
    select PFLASH_CFI01
    select SERIAL_MM
    select SSI_M25P80
    select XILINX
    select XILINX_AXI
    select XILINX_ETHLITE
    select XILINX_SPI

config XLNX_ZYNQMP_PMU
    bool
    default y
    depends on MICROBLAZE
    select XLNX_ZYNQMP
```

## hw/mips/Kconfig
```kconfig
config MALTA
    bool
    default y
    depends on MIPS
    imply PCNET_PCI
    imply PCI_DEVICES
    imply TEST_DEVICES
    select FDC37M81X
    select GT64120
    select MIPS_CPS
    select PIIX
    select PFLASH_CFI01
    select SERIAL_MM
    select SMBUS_EEPROM

config JAZZ
    bool
    default y
    depends on MIPS64
    select ISA_BUS
    select RC4030
    select I8259
    select I8254
    select I8257
    select PCSPK
    select VGA_MMIO
    select G364FB
    select DP8393X
    select ESP
    select FDC_SYSBUS
    select MC146818RTC
    select PCKBD
    select SERIAL_MM
    select PARALLEL
    select DS1225Y
    select JAZZ_LED

config FULOONG
    bool
    default y
    depends on MIPS64 && !TARGET_BIG_ENDIAN
    imply PCI_DEVICES
    imply TEST_DEVICES
    imply ATI_VGA
    imply RTL8139_PCI
    select PCI_BONITO
    select SMBUS_EEPROM
    select VT82C686

config LOONGSON3V
    bool
    default y
    depends on MIPS64 && !TARGET_BIG_ENDIAN
    imply PCI_DEVICES
    imply TEST_DEVICES
    imply VIRTIO_PCI
    imply VIRTIO_NET
    imply VIRTIO_VGA
    imply QXL if SPICE
    imply USB_OHCI_PCI
    select SERIAL_MM
    select GOLDFISH_RTC
    select LOONGSON_IPI
    select LOONGSON_LIOINTC
    select PCI_EXPRESS_GENERIC_BRIDGE
    select MSI_NONBROKEN
    select FW_CFG_MIPS
    select UNIMP

config MIPS_CPS
    bool
    select MIPS_ITU if TCG

config MIPS_BOSTON
    bool
    default y
    depends on MIPS64 && !TARGET_BIG_ENDIAN && FDT
    imply PCI_DEVICES
    imply TEST_DEVICES
    select DEVICE_TREE
    select FITLOADER
    select MIPS_CPS
    select PCI_EXPRESS_XILINX
    select AHCI_ICH9
    select SERIAL_MM

config FW_CFG_MIPS
    bool
```

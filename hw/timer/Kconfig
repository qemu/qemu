## hw/timer/Kconfig
```kconfig
config ARM_TIMER
    bool
    select PTIMER

config ARM_MPTIMER
    bool
    select PTIMER

config A9_GTIMER
    bool

config HPET
    bool
    default y if PC
    # The HPET has both a Rust and a C implementation
    select HPET_C if !HAVE_RUST
    select X_HPET_RUST if HAVE_RUST

config HPET_C
    bool

config I8254
    bool
    depends on ISA_BUS

config ALLWINNER_A10_PIT
    bool
    select PTIMER

config PXA2XX_TIMER
    bool

config SIFIVE_PWM
    bool

config STM32F2XX_TIMER
    bool

config CMSDK_APB_TIMER
    bool
    select PTIMER

config CMSDK_APB_DUALTIMER
    bool
    select PTIMER

config SH_TIMER
    bool
    select PTIMER

config RENESAS_TMR
    bool

config RENESAS_CMT
    bool

config SSE_COUNTER
    bool

config SSE_TIMER
    bool

config STELLARIS_GPTM
    bool

config AVR_TIMER16
    bool
```

## hw/tpm/Kconfig
```kconfig
config TPM_TIS_I2C
    bool
    depends on TPM
    select TPM_BACKEND
    select I2C
    select TPM_TIS

config TPM_TIS_ISA
    bool
    depends on TPM && ISA_BUS
    select TPM_TIS

config TPM_TIS_SYSBUS
    bool
    depends on TPM
    select TPM_TIS

config TPM_TIS
    bool
    depends on TPM
    select TPM_BACKEND

config TPM_CRB
    bool
    depends on TPM && PC
    select TPM_BACKEND

config TPM_SPAPR
    bool
    default y
    depends on TPM && PSERIES
    select TPM_BACKEND
```

## hw/tricore/Kconfig
```kconfig
config TRICORE_TESTBOARD
    default y
    depends on TRICORE
    bool

config TRIBOARD
    bool
    default y
    depends on TRICORE
    select TC27X_SOC

config TC27X_SOC
    bool

config TC4X_BOARD
    bool
    default y
    depends on TRICORE
    select TC4X_SOC

config TC4X_SOC
    bool
    select UNIMP
```

## hw/uefi/Kconfig
```kconfig
config UEFI_VARS
	bool
        default y if X86_64 || AARCH64 || RISCV64 || LOONGARCH64
```

## hw/usb/Kconfig
```kconfig
config USB
    bool

config USB_UHCI
    bool
    default y if PCI_DEVICES
    depends on PCI
    select USB

config USB_OHCI
    bool
    select USB

config USB_OHCI_SYSBUS
    bool
    select USB_OHCI

config USB_OHCI_PCI
    bool
    default y if PCI_DEVICES
    depends on PCI
    select USB_OHCI

config USB_EHCI
    bool
    select USB

config USB_EHCI_PCI
    bool
    default y if PCI_DEVICES
    select USB_EHCI

config USB_EHCI_SYSBUS
    bool
    select USB_EHCI

config USB_XHCI
    bool
    select USB

config USB_XHCI_PCI
    bool
    default y if PCI_DEVICES || PCIE_DEVICES
    depends on PCI
    select USB_XHCI

config USB_XHCI_NEC
    bool
    default y if PCI_DEVICES
    select USB_XHCI_PCI

config USB_XHCI_SYSBUS
    bool
    select USB_XHCI

config USB_MUSB
    bool
    select USB

config USB_DWC2
    bool
    select USB

config TUSB6010
    bool
    select USB_MUSB

config USB_TABLET_WACOM
    bool
    default y
    depends on USB

config USB_STORAGE_CORE
    bool
    depends on USB
    select SCSI

config USB_STORAGE_CLASSIC
    bool
    default y
    depends on USB
    select USB_STORAGE_CORE

config USB_STORAGE_BOT
    bool
    default y
    depends on USB
    select USB_STORAGE_CORE

config USB_STORAGE_UAS
    bool
    default y
    depends on USB
    select SCSI

config USB_AUDIO
    bool
    default y
    depends on USB

config USB_SERIAL
    bool
    default y
    depends on USB

config USB_NETWORK
    bool
    default y
    depends on USB

config USB_SMARTCARD
    bool
    default y
    depends on USB

config USB_STORAGE_MTP
    bool
    default y
    depends on USB

config USB_U2F
    bool
    default y
    depends on USB

config USB_CANOKEY
    bool
    default y
    depends on USB

config IMX_USBPHY
    bool
    default y
    depends on USB

config USB_DWC3
    bool
    select USB_XHCI_SYSBUS
    select REGISTER

config XLNX_USB_SUBSYS
    bool
    select USB_DWC3
```

## hw/vfio-user/Kconfig
```kconfig
# SPDX-License-Identifier: GPL-2.0-or-later

config VFIO_USER
    bool
    default y
    depends on VFIO_PCI
```

## hw/vfio/Kconfig
```kconfig
# SPDX-License-Identifier: GPL-2.0-or-later

config VFIO
    bool
    depends on LINUX

config VFIO_PCI
    bool
    default y
    select VFIO
    select EDID
    depends on LINUX && PCI

config VFIO_CCW
    bool
    default y
    select VFIO
    depends on LINUX && S390_CCW_VIRTIO

config VFIO_AP
    bool
    default y
    select VFIO
    depends on LINUX && S390_CCW_VIRTIO

config VFIO_IGD
    bool
    default y if PC_PCI
    depends on VFIO_PCI
```

## hw/virtio/Kconfig
```kconfig
config VIRTIO
    bool

config VIRTIO_RNG
    bool
    default y
    depends on VIRTIO

config VIRTIO_IOMMU
    bool
    default y
    depends on PCI && VIRTIO

config VIRTIO_PCI
    bool
    default y if PCI_DEVICES
    depends on PCI
    select VIRTIO

config VIRTIO_MMIO
    bool
    select VIRTIO

config VIRTIO_CCW
    bool
    select VIRTIO

config VIRTIO_BALLOON
    bool
    default y
    depends on VIRTIO

config VIRTIO_CRYPTO
    bool
    default y
    depends on VIRTIO

config VIRTIO_MD
    bool
    select MEM_DEVICE

config VIRTIO_PMEM_SUPPORTED
    bool

config VIRTIO_PMEM
    bool
    default y
    depends on VIRTIO
    depends on VIRTIO_PMEM_SUPPORTED
    select VIRTIO_MD

config VIRTIO_MEM_SUPPORTED
    bool

config VIRTIO_MEM
    bool
    default y
    depends on VIRTIO
    depends on LINUX
    depends on VIRTIO_MEM_SUPPORTED
    select VIRTIO_MD

config VHOST_VSOCK_COMMON
    bool
    depends on VIRTIO

config VHOST_VSOCK
    bool
    default y
    select VHOST_VSOCK_COMMON
    depends on VIRTIO && VHOST_KERNEL

config VHOST_USER_VSOCK
    bool
    default y
    select VHOST_VSOCK_COMMON
    depends on VIRTIO && VHOST_USER

config VHOST_USER_I2C
    bool
    default y
    depends on VIRTIO && VHOST_USER

config VHOST_USER_RNG
    bool
    default y
    depends on VIRTIO && VHOST_USER

config VHOST_USER_FS
    bool
    default y
    depends on VIRTIO && VHOST_USER

config VHOST_USER_GPIO
    bool
    default y
    depends on VIRTIO && VHOST_USER

config VHOST_VDPA_DEV
    bool
    default y
    depends on VIRTIO && VHOST_VDPA && LINUX

config VHOST_USER_SND
    bool
    default y
    depends on VIRTIO && VHOST_USER

config VHOST_USER_SCMI
    bool
    default y
    depends on VIRTIO && VHOST_USER
```

## hw/vmapple/Kconfig
```kconfig
# SPDX-License-Identifier: GPL-2.0-or-later

config VMAPPLE_AES
    bool

config VMAPPLE_BDIF
    bool

config VMAPPLE_CFG
    bool

config VMAPPLE_VIRTIO_BLK
    bool

config VMAPPLE
    bool
    depends on ARM
    depends on HVF
    default y if ARM
    imply PCI_DEVICES
    select ARM_GICV3
    select PLATFORM_BUS
    select PCI_EXPRESS
    select PCI_EXPRESS_GENERIC_BRIDGE
    select PL011 # UART
    select PL031 # RTC
    select PL061 # GPIO
    select GPIO_PWR
    select PVPANIC_MMIO
    select VMAPPLE_AES
    select VMAPPLE_BDIF
    select VMAPPLE_CFG
    select MAC_PVG_MMIO
    select VMAPPLE_VIRTIO_BLK
```

## hw/watchdog/Kconfig
```kconfig
config CMSDK_APB_WATCHDOG
    bool
    select PTIMER

config WDT_IB6300ESB
    bool
    default y if PCI_DEVICES
    depends on PCI

config WDT_IB700
    bool
    default y
    depends on ISA_BUS

config WDT_DIAG288
    bool
```

## hw/xtensa/Kconfig
```kconfig
config XTENSA_SIM
    default y
    depends on XTENSA
    bool

config XTENSA_VIRT
    bool
    default y
    depends on XTENSA
    select XTENSA_SIM
    select PCI_EXPRESS_GENERIC_BRIDGE
    select PCI_DEVICES

config XTENSA_XTFPGA
    bool
    default y
    depends on XTENSA && FDT
    select DEVICE_TREE
    select OPENCORES_ETH
    select PFLASH_CFI01
    select SERIAL_MM
```

## semihosting/Kconfig
```kconfig
config SEMIHOSTING
       bool
       depends on TCG

config ARM_COMPATIBLE_SEMIHOSTING
       bool
       select SEMIHOSTING
```

## target/Kconfig
```kconfig
source alpha/Kconfig
source arm/Kconfig
source avr/Kconfig
source hppa/Kconfig
source i386/Kconfig
source loongarch/Kconfig
source m68k/Kconfig
source microblaze/Kconfig
source mips/Kconfig
source openrisc/Kconfig
source ppc/Kconfig
source riscv/Kconfig
source rx/Kconfig
source s390x/Kconfig
source sh4/Kconfig
source sparc/Kconfig
source tricore/Kconfig
source xtensa/Kconfig

config TARGET_BIG_ENDIAN
    bool
```

## target/arm/Kconfig
```kconfig
config ARM
    bool
    select ARM_COMPATIBLE_SEMIHOSTING if TCG

    # We need to select this until we move m_helper.c and the
    # translate.c v7m helpers under ARM_V7M.
    select ARM_V7M if TCG

    select DEVICE_TREE # needed by boot.c

config AARCH64
    bool
    select ARM
    # kvm_arch_fixup_msi_route() needs to access PCIDevice
    select PCI if KVM
```

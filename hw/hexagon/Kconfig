## hw/hexagon/Kconfig
```kconfig
config HEX_DSP
    bool
    default y
    depends on HEXAGON
    select CPU_CLUSTER
    select HEX_L2VIC
    select HEX_QTIMER
    select ARM_COMPATIBLE_SEMIHOSTING

config HEX_BOARD
    bool
    depends on HEX_DSP && FDT
    select DEVICE_TREE
    select VIRTIO_MMIO
    select PL011

config HEX_VIRT
    bool
    default y
    depends on HEX_DSP && FDT
    select HEX_BOARD
    select VIRTIO_BLK
    select VIRTIO_SCSI

config HEX_QCOM_DSP
    bool
    depends on HEX_DSP && FDT
    select HEX_BOARD
    select UNIMP
    select QCOM_QDSP6SS_CLK
    select VIRTIO_BLK
    select VIRTIO_SCSI

config HEX_QCS6490_CDSP
    bool
    default y
    depends on HEX_DSP && FDT
    select HEX_QCOM_DSP

config HEX_SA8775P_CDSP
    bool
    default y
    depends on HEX_DSP && FDT
    select HEX_QCOM_DSP
```

## hw/ufs/Kconfig
```kconfig
config UFS
    bool
    select SCSI

config UFS_PCI
    bool
    default y if PCI_DEVICES
    depends on PCI
    select UFS

config UFS_SYSBUS
    bool
    select UFS
```

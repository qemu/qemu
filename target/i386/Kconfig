## target/i386/Kconfig
```kconfig
config I386
    bool
    select APIC
    # kvm_arch_fixup_msi_route() needs to access PCIDevice
    select PCI if KVM

config X86_64
    bool
    select I386
```

## target/mips/Kconfig
```kconfig
config MIPS
    bool
    imply SEMIHOSTING if TCG

config MIPS64
    bool
    select MIPS
```

## target/riscv/Kconfig
```kconfig
config RISCV32
    bool
    select ARM_COMPATIBLE_SEMIHOSTING if TCG
    select DEVICE_TREE # needed by boot.c

config RISCV64
    bool
    select ARM_COMPATIBLE_SEMIHOSTING if TCG
    select DEVICE_TREE # needed by boot.c
```

## target/s390x/Kconfig
```kconfig
config S390X
    bool
    select PCI
    select S390_FLIC

config S390X_LEGACY_CPUS
    bool
    default y
    depends on S390X
```

## target/sh4/Kconfig
```kconfig
config SH4
    bool
    # needed for sh_intc_get_pending_vector
    select SH_INTC
```
